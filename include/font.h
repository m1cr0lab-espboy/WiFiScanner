/**
 * ----------------------------------------------------------------------------
 * @file   font.h
 * @author Stéphane Calderoni (https://github.com/m1cr0lab)
 * @brief  Toolbox for displaying a custom font
 * ----------------------------------------------------------------------------
 */

#pragma once

#include <ESPboy.h>

uint8_t constexpr FONT_SIZE   = 5;
uint8_t constexpr LINE_HEIGHT = FONT_SIZE * 2;

uint8_t const constexpr FONT[] PROGMEM = {

    0x00, 0x00, 0x00, 0x00, 0x00, // ' '
    0x01, 0x01, 0x01, 0x00, 0x01, // !
    0x05, 0x05, 0x00, 0x00, 0x00, // "
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    0x00, 0x00, 0x00, 0x00, 0x15  // ... chr(127)
    
};

uint8_t const constexpr FONT_WIDTH[] PROGMEM = {

    2, 1, 3, 5, 5, 5, 5, 1, 2, 2, 3, 3, 2, 3, 1, 5,
    5, 2, 4, 4, 5, 4, 5, 5, 5, 5, 1, 2, 3, 3, 3, 4,
    5, 5, 5, 4, 5, 4, 4, 5, 4, 3, 4, 4, 4, 5, 5, 5,
    5, 5, 5, 4, 5, 5, 5, 5, 4, 5, 4, 2, 5, 2, 3, 4,
    2, 5, 5, 4, 5, 4, 4, 5, 4, 3, 4, 4, 4, 5, 5, 5,
    5, 5, 5, 4, 5, 5, 5, 5, 4, 5, 4, 3, 1, 3, 4, 5

};

enum class Align : uint8_t { LEFT, CENTER, RIGHT };

void drawString(LovyanGFX * const dest, char const * const str, int16_t x, int16_t const y, uint16_t const color = 0xffff, Align const align = Align::LEFT) {

    uint8_t  const n   = strlen(str);
    uint16_t       len = n - 1; // char spacing
    uint8_t        width[n];

    for (uint8_t i = 0; i < n; ++i) {
        uint8_t const c = (str[i] - 32) & 0x7f;
        len += (width[i] = pgm_read_byte(FONT_WIDTH + c));
    }

    switch (align) {
        case Align::CENTER: x -= len >> 1; break;
        case Align::RIGHT:  x -= len;      break;
        default:;
    }

    for (uint8_t i = 0; i < n; ++i) {
        uint8_t const c = (str[i] - 32) & 0x7f;
        uint8_t const w = width[i];
        for (uint8_t j = 0; j < FONT_SIZE; ++j) {
            uint8_t const row = pgm_read_byte(FONT + c * FONT_SIZE + j);
            for (uint8_t k = 0; k < w; ++k) {
                if (row & (1 << k)) dest->drawPixel(x + w - 1 - k, y + j, color);
            }
        }
        x += w + 1;
    }

}

void drawString(LovyanGFX * const dest, __FlashStringHelper const * const str, int16_t x, int16_t const y, uint16_t const color = 0xffff, Align const align = Align::LEFT) {

    uint8_t len = strlen_P((PGM_P)str);
    char    buffer[len + 1];
    strncpy_P(buffer, (PGM_P)str, len + 1);
    drawString(dest, buffer, x, y, color, align);

}

/*
 * ----------------------------------------------------------------------------
 * ESPboy WiFi Scanner
 * ----------------------------------------------------------------------------
 * Copyright (c) 2022 Stéphane Calderoni (https://github.com/m1cr0lab)
 * 
 *     Based on an original idea from tobozo (https://github.com/tobozo)
 *     => https://twitter.com/TobozoTagada/status/1469018514702974981
 * 
 * This program is free software: you can redistribute it and/or modify
 * it under the terms of the GNU General Public License as published by
 * the Free Software Foundation, either version 3 of the License, or
 * (at your option) any later version.
 * 
 * This program is distributed in the hope that it will be useful,
 * but WITHOUT ANY WARRANTY; without even the implied warranty of
 * MERCHANTABILITY or FITNESS FOR A PARTICULAR PURPOSE. See the
 * GNU General Public License for more details.
 * 
 * You should have received a copy of the GNU General Public License
 * along with this program. If not, see <https://www.gnu.org/licenses/>.
 * ----------------------------------------------------------------------------
 */